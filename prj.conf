## CMakeLists.txt
```
# SPDX-License-Identifier: Apache-2.0

cmake_minimum_required(VERSION 3.20.0)
set(QEMU_EXTRA_FLAGS -s)

find_package(Zephyr REQUIRED HINTS $ENV{ZEPHYR_BASE})
project(mesh-scan-coexist)

target_sources(
  app PRIVATE
  src/hw_config.c
  src/main.c
  src/node.c
  src/peer.c
  src/provisioning.c
)

target_include_directories(app PRIVATE include)

if (CONFIG_BUILD_WITH_TFM)
  target_include_directories(app PRIVATE
    $<TARGET_PROPERTY:tfm,TFM_BINARY_DIR>/api_ns/interface/include
  )
endif()
```

## prj.conf
```kconfig
CONFIG_MAIN_STACK_SIZE=2048
CONFIG_SYSTEM_WORKQUEUE_STACK_SIZE=2048

CONFIG_MAIN_THREAD_PRIORITY=-2
CONFIG_DK_LIBRARY=y

CONFIG_BT=y
CONFIG_BT_OBSERVER=y
CONFIG_BT_BROADCASTER=y

CONFIG_LOG_MODE_DEFERRED=y

CONFIG_BT_CTLR_PRIVACY=n
CONFIG_BT_CTLR_CHAN_SEL_2=n

CONFIG_BT_MESH=y
CONFIG_BT_MESH_SUBNET_COUNT=1
CONFIG_BT_MESH_APP_KEY_COUNT=1
CONFIG_BT_MESH_ADV_BUF_COUNT=10
CONFIG_BT_MESH_TX_SEG_MAX=8
CONFIG_BT_MESH_TX_SEG_MSG_COUNT=5
CONFIG_BT_MESH_RX_SEG_MAX=32
CONFIG_BT_MESH_MODEL_GROUP_COUNT=2
CONFIG_BT_MESH_LABEL_COUNT=0
CONFIG_BT_MESH_CFG_CLI=y
CONFIG_BT_MESH_BEACON_ENABLED=n
CONFIG_BT_MESH_RELAY=y
CONFIG_BT_MESH_RELAY_RETRANSMIT_COUNT=2

CONFIG_BT_MESH_PROVISIONER=y
CONFIG_BT_MESH_PROVISIONEE=y
CONFIG_BT_MESH_CDB=y
CONFIG_BT_MESH_CDB_NODE_COUNT=16
CONFIG_BT_MESH_CDB_SUBNET_COUNT=3
CONFIG_BT_MESH_CDB_APP_KEY_COUNT=3

CONFIG_FLASH=y
CONFIG_FLASH_PAGE_LAYOUT=y
CONFIG_FLASH_MAP=y
CONFIG_NVS=y
CONFIG_SETTINGS=n
CONFIG_BT_SETTINGS=n

CONFIG_LOG=y
CONFIG_LOG_BUFFER_SIZE=4096
CONFIG_LOG_PRINTK=y
CONFIG_LOG_BACKEND_RTT=y
CONFIG_CONSOLE=y
CONFIG_UART_CONSOLE=y
CONFIG_USE_SEGGER_RTT=y
CONFIG_RTT_CONSOLE=y

CONFIG_BT_HOST_CRYPTO=n

# For scanning

CONFIG_BT_CENTRAL=y
CONFIG_BT_PERIPHERAL=y

CONFIG_BT_SCAN=y
CONFIG_BT_SCAN_FILTER_ENABLE=y
CONFIG_BT_SCAN_NAME_CNT=1
CONFIG_BT_SCAN_MANUFACTURER_DATA_CNT=1
CONFIG_BT_SCAN_WITH_IDENTITY=y
CONFIG_BT_ID_MAX=2

CONFIG_BT_EXT_ADV=y
CONFIG_BT_DEVICE_NAME="SCAN_M"

# NETWORK PARAMS
CONFIG_BT_MESH_RELAY_ADV_SETS=5
#CONFIG_BT_EXT_ADV_MAX_ADV_SET=6
CONFIG_BT_EXT_ADV_MAX_ADV_SET=7
CONFIG_BT_MESH_RELAY_BUF_COUNT=256
CONFIG_BT_MESH_RELAY_RETRANSMIT_INTERVAL=20

### From provisioner

CONFIG_SERIAL=y
CONFIG_UART_INTERRUPT_DRIVEN=y
CONFIG_RING_BUFFER=y

### From node
CONFIG_BT_MESH_PB_ADV=y

CONFIG_MPSL=y
CONFIG_MPSL_TIMESLOT_SESSION_COUNT=2

# For UUID
CONFIG_HWINFO=y

# TODO: Remove
# CONFIG_DEBUG_COREDUMP=y
# CONFIG_DEBUG_COREDUMP_BACKEND_LOGGING=y
CONFIG_EXTRA_EXCEPTION_INFO=y
CONFIG_THREAD_NAME=y
```

## boards/nrf5340dk_nrf5340_cpuapp_ns.conf
```kconfig
# The option adds TinyCrypt based bt_rand.
CONFIG_BT_HOST_CRYPTO=n

# Known issue: non secure platforms do not work with settings subsystem.
CONFIG_SETTINGS=n
CONFIG_BT_SETTINGS=n
CONFIG_DK_LIBRARY=y
```

## src/main.c
```c
/*
 * Copyright (c) 2019 Tobias Svehagen
 *
 * SPDX-License-Identifier: Apache-2.0
 */

#include <zephyr/sys/printk.h>
#include <zephyr/settings/settings.h>
#include <zephyr/bluetooth/bluetooth.h>
#include <zephyr/bluetooth/mesh.h>

#include <zephyr/logging/log.h>
LOG_MODULE_REGISTER(mesh_scan_coexist, LOG_LEVEL_DBG);

#include "provisioning.h"
#include "node.h"
#include "hw_config.h"

#include "peer.h"

// Change between 0 and 1 to change mesh and peer start order
// 0 - first mesh, then peer
// 1 - first peer, then mesh
#define ALTERNATIVE_SEQUENCE 0

// If your board is not a nordic DK, you can select whenever your board is a provisioner or not here
#define CONFIG_FOR_NON_DK__IS_PROVISIONER 0

static bool is_provisioner = false;

static int mesh_start(void) {
	int err = 0;
	if(is_provisioner) {
		LOG_INF("Starting as provisioner");
		err = provisining_init();
		if (err) {
			LOG_ERR("Provisioning init failed (err %d)", err);
			return err;
		}

		err = bt_mesh_init(&provisioner_prov, &provisioner_mesh_comp);
		if (err) {
			LOG_ERR("Initializing mesh failed (err %d)", err);
			return err;
		}
		
		err = provisioning_start();	
		if (err) {
			LOG_ERR("Provisioning start failed (err %d)", err);
			return err;
		}

	} else {
		LOG_INF("Starting as regular node");
		err = bt_mesh_init(&node_prov, &node_mesh_comp);
		if (err) {
			LOG_ERR("Initializing mesh failed (err %d)", err);
			return err;
		}

		err = node_start();
		if (err) {
			LOG_ERR("Node init failed (err %d)", err);
			return err;
		}
	}
	return err;
}


static void bt_ready(int err)
{
	if (err) {
		LOG_ERR("Bluetooth init failed (err %d)", err);
		return;
	}

	LOG_INF("Bluetooth initialized");

	#if IS_ENABLED(ALTERNATIVE_SEQUENCE) // First peer, then mesh
		err = peer_start();
		if (err) {
			LOG_ERR("Peer start failed (err %d)", err);
			return;
		}
	
		err = mesh_start();
		if (err) {
			LOG_ERR("Mesh start failed (err %d)", err);
			return;
		}
	#else // First mesh, then peer
		err = mesh_start();
		if (err) {
			LOG_ERR("Mesh start failed (err %d)", err);
			return;
		}
	
		err = peer_start();
		if (err) {
			LOG_ERR("Peer start failed (err %d)", err);
			return;
		}

	#endif
}


int main(void)
{
	int err = 0;
	LOG_INF("Initializing...");

	err = hw_init(CONFIG_FOR_NON_DK__IS_PROVISIONER);
	if (err) {
		LOG_ERR("Hardware init failed (err %d)", err);
		return err;
	}
	LOG_INF(" - Hardware initialized");

	is_provisioner = hw_provisioner_button_pressed();

	/* Initialize the Bluetooth Subsystem */
	err = bt_enable(bt_ready);
	if (err) {
		LOG_ERR("Bluetooth init failed (err %d)", err);
		return err;
	}
	LOG_INF(" - Bluetooth initialized");

	while(true) {
		k_sleep(K_MSEC(500));
	}
	return 0;
}
```

## include/fake_kconfig.h
```c
#ifndef __FAKE_KCONFIG__
#define __FAKE_KCONFIG__

#define BL_NORDIC_COMPANY_ID 0x0059
#define CONFIG_BL_COMPOSITION_COMPANY_ID BL_NORDIC_COMPANY_ID

#define CONFIG_BL_MESH_PROVISIONING_STACK_SIZE 2048
#define CONFIG_BL_MESH_PROVISIONING_PRIORITY -2

#define CONFIG_SENSIBLE_DATA 1

#endif /* __FAKE_KCONFIG__ */
```

## include/hw_config.h
```c
#ifndef __HW_CONFIG_H__
#define __HW_CONFIG_H__

#include <stdint.h>
#include <stdbool.h>

extern uint8_t dev_uuid[16];
extern uint64_t dev_uid64;

int hw_init(bool provisioner_button_value_if_not_dk);
bool hw_provisioner_button_pressed(void);

#endif /* __HW_CONFIG_H__ */
```

## include/node.h
```c
#ifndef __MESH_NODE_H__
#define __MESH_NODE_H__

extern const struct bt_mesh_comp node_mesh_comp;
extern const struct bt_mesh_prov node_prov;

int node_start(void);

#endif /* __MESH_NODE_H__ */
```

## include/peer.h
```c
/*
 * Copyright (c) 2021 Nordic Semiconductor ASA
 *
 * SPDX-License-Identifier: LicenseRef-Nordic-5-Clause
 */

#ifndef __PEER_H_
#define __PEER_H_

#ifdef __cplusplus
extern "C" {
#endif

#include <zephyr/kernel.h>
#include <zephyr/bluetooth/addr.h>
#include <math.h>

struct peer_entry {
	sys_snode_t node;
	bt_addr_le_t bt_addr;
	uint64_t hw_id;
	uint16_t timeout_ms;
};

int peer_start();


#ifdef __cplusplus
}
#endif

#endif /* __PEER_H_ */
```

## include/provisioning.h
```c
#ifndef __MESH_PROVISIONING_H__
#define __MESH_PROVISIONING_H__

extern const struct bt_mesh_comp provisioner_mesh_comp;
extern const struct bt_mesh_prov provisioner_prov;

int provisining_init(void);
int provisioning_start(void);

#endif /* __MESH_PROVISIONING_H__ */
```

## src/hw_config.c
```c
#include <string.h>

#include <zephyr/sys/util_macro.h>
#if IS_ENABLED(CONFIG_HWINFO)
#include <zephyr/drivers/hwinfo.h>
#endif
#include <zephyr/logging/log.h>

#if IS_ENABLED(CONFIG_DK_LIBRARY)
#include <dk_buttons_and_leds.h>
#endif

#include "hw_config.h"

LOG_MODULE_REGISTER(hw_config, LOG_LEVEL_DBG);

/* Provisioner button */
#if IS_ENABLED(CONFIG_DK_LIBRARY)
#define PROVISIONER_BUTTON DK_BTN1
#else
#define PROVISIONER_BUTTON 0
#endif

#define PROVISIONER_BUTTON_MSK BIT(PROVISIONER_BUTTON)

static bool provisioner_button_state = false;

#if IS_ENABLED(CONFIG_DK_LIBRARY)
static void button_handler(uint32_t button_state, uint32_t has_changed) {
	if (has_changed & PROVISIONER_BUTTON_MSK) {
		provisioner_button_state = button_state & PROVISIONER_BUTTON_MSK;
		LOG_DBG("Provisioner button state is %s", provisioner_button_state ? "pressed" : "released");
	}
}
#endif

bool hw_provisioner_button_pressed(void) {
	return provisioner_button_state;
}

/* UUID */
uint8_t dev_uuid[16] = { 0xdd, 0xdd };
uint64_t dev_uid64 = { 0 };

static int uuid_from_hw(void) {

	int err = 0;

	if(IS_ENABLED(CONFIG_HWINFO)) {
		err = hwinfo_get_device_id((uint8_t*)(&dev_uid64), sizeof(dev_uid64));
		if (err < 0) {
			LOG_ERR("Failed to get device UID64 (err %d)", err);
			return err;
		}
	} else {
		LOG_WRN("CONFIG_HWINFO is not enabled, using default UID64");
	}

    err = 0;
    if (IS_ENABLED(CONFIG_HWINFO)) {
		err = hwinfo_get_device_id(dev_uuid, sizeof(dev_uuid));
		if (err < 0) {
			LOG_ERR("Failed to get device UUID (err %d)", err);
			return err;
		}
	} else {
		LOG_WRN("CONFIG_HWINFO is not enabled, using default UUID");
	}

	if (err < 0) {
        memset(dev_uuid, 0, sizeof(dev_uuid));
		dev_uuid[0] = 0xdd;
		dev_uuid[1] = 0xdd;
	}

    return 0;
}

/* Init */
int hw_init(bool provisioner_button_value_if_not_dk) {
	int err = 0;

	#if IS_ENABLED(CONFIG_DK_LIBRARY)
	err = dk_buttons_init(button_handler);
	if (err) {
		LOG_ERR("Failed to initialize buttons (err %d)", err);
		return err;
	}

	uint32_t button_state = 0;
	uint32_t has_changed = 0;	
	dk_read_buttons(&button_state, &has_changed);
	has_changed = ~0;
	button_handler(button_state, has_changed);
	#else
	provisioner_button_state = provisioner_button_value_if_not_dk;
	#endif

	err = uuid_from_hw();
	if (err) {
		LOG_ERR("Failed to get device UUID (err %d)", err);
		return err;
	}

	return 0;
}
```

## src/node.c
```c
#include <zephyr/logging/log.h>
#include <zephyr/bluetooth/mesh.h>

#include "fake_kconfig.h"

#include "node.h"
#include "hw_config.h"

/* TODO: Parametrized logging */
LOG_MODULE_REGISTER(node, LOG_LEVEL_DBG);

static void prov_complete(uint16_t net_idx, uint16_t addr)
{
	LOG_INF("================");
	LOG_INF("NODE PROVISIONED");
	LOG_INF("================");
}

static void prov_reset(void)
{
	(void)bt_mesh_prov_enable(BT_MESH_PROV_ADV | BT_MESH_PROV_GATT);
}

const struct bt_mesh_prov node_prov = {
	.uuid = dev_uuid,
	.complete = prov_complete,
	.reset = prov_reset,
};

static const struct bt_mesh_model sig_models[] = {
	BT_MESH_MODEL_CFG_SRV,
};

static struct bt_mesh_model vnd_models[] = { };

static const struct bt_mesh_elem elements[] = {
	BT_MESH_ELEM(0, sig_models, vnd_models),
};

const struct bt_mesh_comp node_mesh_comp = {
	.cid = CONFIG_BL_COMPOSITION_COMPANY_ID,
	.elem = elements,
	.elem_count = ARRAY_SIZE(elements),
};

int node_start(void)
{
	int err = 0;
	if (IS_ENABLED(CONFIG_SETTINGS)) {
		err = settings_load();
        if (err) {
            LOG_ERR("Failed to load settings (err %d)", err);
        }
	}

	err = bt_mesh_prov_enable(BT_MESH_PROV_ADV | BT_MESH_PROV_GATT);
    if (err) {
        LOG_ERR("Failed to enable provisioning (err %d)", err);
        return err;
    }

	LOG_INF("Mesh initialized");
    return err;
}
```

## src/peer.c
```c
/*
 * Copyright (c) 2021 Nordic Semiconductor ASA
 *
 * SPDX-License-Identifier: LicenseRef-Nordic-5-Clause
 */

#include <zephyr/kernel.h>
#include <zephyr/bluetooth/bluetooth.h>
#include <zephyr/sys/byteorder.h>
#include <bluetooth/scan.h>

#include <zephyr/logging/log.h>
LOG_MODULE_REGISTER(peer, LOG_LEVEL_DBG);

#include "hw_config.h"
#include "peer.h"

#define DEVICE_NAME             CONFIG_BT_DEVICE_NAME
#define DEVICE_NAME_LEN         (sizeof(DEVICE_NAME) - 1)

#define SUPPORT_PEER_CODE         0xAABBDDFF

struct adv_mfg_data {
	uint16_t company_code;
	uint32_t support_peer_code;
	uint64_t hw_id;
} __packed;

static struct adv_mfg_data mfg_data = { 0 };
struct bt_le_adv_param adv_param_conn =
	BT_LE_ADV_PARAM_INIT(BT_LE_ADV_OPT_CONNECTABLE |
			     BT_LE_ADV_OPT_NOTIFY_SCAN_REQ,
			     BT_GAP_ADV_FAST_INT_MIN_2,
			     BT_GAP_ADV_FAST_INT_MAX_2,
			     NULL);

struct bt_le_adv_param adv_param_noconn =
	BT_LE_ADV_PARAM_INIT(BT_LE_ADV_OPT_USE_IDENTITY |
			     BT_LE_ADV_OPT_SCANNABLE |
			     BT_LE_ADV_OPT_NOTIFY_SCAN_REQ,
			     BT_GAP_ADV_FAST_INT_MIN_2,
			     BT_GAP_ADV_FAST_INT_MAX_2,
			     NULL);


struct bt_le_adv_param *adv_param = &adv_param_conn;

static const struct bt_data ad[] = {
	BT_DATA_BYTES(BT_DATA_FLAGS, (BT_LE_AD_GENERAL | BT_LE_AD_NO_BREDR)),
	BT_DATA(BT_DATA_NAME_COMPLETE, DEVICE_NAME, DEVICE_NAME_LEN),
};

static const struct bt_data sd[] = {
	BT_DATA(BT_DATA_MANUFACTURER_DATA, (unsigned char *)&mfg_data, sizeof(mfg_data)),
};

static struct bt_le_scan_param scan_param = {
	.type     = BT_LE_SCAN_TYPE_ACTIVE,
	.interval = BT_GAP_SCAN_FAST_INTERVAL,
	.window   = BT_GAP_SCAN_FAST_WINDOW,
	.options  = BT_LE_SCAN_OPT_NONE,
	.timeout  = 0,
};

static struct bt_scan_init_param scan_init = {
	.connect_if_match = 0,
	.scan_param = &scan_param,
	.conn_param = NULL
};

static struct bt_scan_manufacturer_data scan_mfg_data = {
	.data = (unsigned char *)&mfg_data,
	.data_len = (
		  sizeof(mfg_data.company_code)
		+ sizeof(mfg_data.support_peer_code)
	),
};

static struct bt_le_ext_adv *adv;
static void adv_work_handle(struct k_work *item);
static K_WORK_DEFINE(adv_work, adv_work_handle);

static bool data_cb(struct bt_data *data, void *user_data)
{
	struct adv_mfg_data *recv_mfg_data;
	
	switch (data->type) {
	/* Simply print the filtered device */
	case BT_DATA_MANUFACTURER_DATA:
		if (sizeof(struct adv_mfg_data) == data->data_len) {
			bt_addr_le_t* addr = user_data;
			recv_mfg_data = (struct adv_mfg_data *)data->data;
			
			char addr_str[BT_ADDR_LE_STR_LEN] = { 0 };
			bt_addr_le_to_str(addr, addr_str, sizeof(addr_str));
			uint64_t hw_id = sys_le64_to_cpu(recv_mfg_data->hw_id);
			LOG_WRN(
				"SCANNED AND FILTERED peer of addr %s and hw_id %" PRIu64,
				addr_str,
				hw_id
			);
		}
		return false;
	default:
		return true;
	}
}

static void scan_filter_match(struct bt_scan_device_info *device_info,
			      struct bt_scan_filter_match *filter_match,
			      bool connectable)
{
	bt_addr_le_t addr;
	bt_addr_le_copy(&addr, device_info->recv_info->addr);
	bt_data_parse(device_info->adv_data, data_cb, &addr);
}

BT_SCAN_CB_INIT(scan_cb, scan_filter_match, NULL, NULL, NULL);

static void adv_scanned_cb(struct bt_le_ext_adv *adv,
			struct bt_le_ext_adv_scanned_info *info)
{
	ARG_UNUSED(adv);
	ARG_UNUSED(info);

	LOG_DBG("SCANNING is working (I've been scanned)");
}

const static struct bt_le_ext_adv_cb adv_cb = {
	.scanned = adv_scanned_cb,
};

static int adv_start(void)
{
	int err;
	struct bt_le_ext_adv_start_param ext_adv_start_param = {0};

	

	if (adv) {
		err = bt_le_ext_adv_stop(adv);
		if (err) {
			LOG_ERR("Failed to stop extended advertising  (err %d)", err);
			return err;
		}
			err = bt_le_ext_adv_delete(adv);
		if (err) {
			LOG_ERR("Failed to delete advertising set  (err %d)", err);
			return err;
		}
	}

	err = bt_le_ext_adv_create(adv_param, &adv_cb, &adv);
	if (err) {
		LOG_ERR("Failed to create advertising set (err %d)", err);
		return err;
	}

	err = bt_le_ext_adv_set_data(adv, ad, ARRAY_SIZE(ad), sd, ARRAY_SIZE(sd));
	if (err) {
		LOG_ERR("Failed setting adv data (err %d)", err);
		return err;
	}

	err = bt_le_ext_adv_start(adv, &ext_adv_start_param);
	if (err) {
		LOG_ERR("Failed to start extended advertising  (err %d)", err);
		return err;
	}

	return err;
}

static void adv_work_handle(struct k_work *item)
{
	adv_start();
}

static void connected(struct bt_conn *conn, uint8_t conn_err)
{
	adv_param = &adv_param_noconn;
	k_work_submit(&adv_work);
}

static void disconnected(struct bt_conn *conn, uint8_t reason)
{
	adv_param = &adv_param_conn;
	k_work_submit(&adv_work);
}

BT_CONN_CB_DEFINE(conn_callbacks) = {
	.connected = connected,
	.disconnected = disconnected,
};


BUILD_ASSERT(CONFIG_BT_ID_MAX >= 2, "Insufficient number of available Bluetooth identities");

static int scan_start(void)
{
	int err;

	bt_scan_init(&scan_init);
	bt_scan_cb_register(&scan_cb);

	err = bt_scan_filter_add(BT_SCAN_FILTER_TYPE_MANUFACTURER_DATA, &scan_mfg_data);
	if (err) {
		LOG_ERR("Scanning filters cannot be set (err %d)", err);
		return err;
	}

	err = bt_scan_filter_enable(BT_SCAN_MANUFACTURER_DATA_FILTER, false);
	if (err) {
		LOG_ERR("Filters cannot be turned on (err %d)", err);
		return err;
	}

	err = bt_scan_start(BT_SCAN_TYPE_SCAN_ACTIVE);
	if(err == -EALREADY) { err = 0; } // Mesh may already started to scan
	if (err) {
		LOG_ERR("Scanning failed to start (err %d)", err);
		return err;
	}

	return err;
}

static int prepare_identity(void)
{
	size_t id_count = 0xFF;

	/* Use different identity from Bluetooth Mesh to avoid conflicts with Mesh Provisioning
	 * Service and Mesh Proxy Service advertisements.
	 */
	(void)bt_id_get(NULL, &id_count);

	if (id_count != 1) {
		LOG_ERR("Expected only default identity so far, there currently are %d", id_count);
		return -EINVAL;
	}

	int id = bt_id_create(NULL, NULL);
	if (id < 0) {
		LOG_ERR("Failed to create identity (err %d)", id);
		return id;
	}

	adv_param_conn.id = id;
	adv_param_noconn.id = id;

	return 0;
}

int peer_start() {
	
	int err = 0;

	mfg_data.company_code = sys_cpu_to_le16(CONFIG_BT_COMPANY_ID_NORDIC);
	mfg_data.support_peer_code = sys_cpu_to_le32(SUPPORT_PEER_CODE);
	mfg_data.hw_id = dev_uid64; // From hw_config.h

	err = prepare_identity();
	if (err) {
		LOG_ERR("Failed to prepare identity (err %d)", err);
		return err;
	}
	
	err = adv_start();
	if (err) {
		LOG_ERR("Failed to start advertising (err %d)", err);
		return err;
	}

	err = scan_start();
	if (err) {
		LOG_ERR("Failed to start scanning (err %d)", err);
		return err;
	}
	
	return err;
}
```

## src/provisioning.c
```c
#include <zephyr/bluetooth/mesh.h>
#include <zephyr/bluetooth/mesh/cfg_cli.h>

#include "fake_kconfig.h"

#include "hw_config.h"
#include "provisioning.h"

/* TODO: Parametrized logging */
#include <zephyr/logging/log.h>
LOG_MODULE_REGISTER(provisioning, LOG_LEVEL_DBG);

K_SEM_DEFINE(sem_unprov_beacon, 0, 1);
K_SEM_DEFINE(sem_node_added, 0, 1);

K_THREAD_STACK_DEFINE(provisioning_stack_area, CONFIG_BL_MESH_PROVISIONING_STACK_SIZE);
struct k_work_q provisioning_queue = { 0 };
const struct k_work_queue_config cfg = {
	.name = "provisioning_queue",
	.no_yield = false,
};

static uint16_t self_addr = 1;
static uint16_t node_addr = 0;
static uint8_t node_uuid[16];
static const uint8_t prov_dev_uuid[16] = { 0xdd, 0xdd };

static const uint16_t net_idx;
static const uint16_t app_idx;

/* Models */
static struct bt_mesh_cfg_cli cfg_cli = { 0 };
static const struct bt_mesh_model sig_models[] = {
	BT_MESH_MODEL_CFG_SRV,
	BT_MESH_MODEL_CFG_CLI(&cfg_cli),
};

static struct bt_mesh_model vnd_models[] = { };

static const struct bt_mesh_elem elements[] = {
	BT_MESH_ELEM(0, sig_models, vnd_models),
};

const struct bt_mesh_comp provisioner_mesh_comp = {
	.cid = CONFIG_BL_COMPOSITION_COMPANY_ID,
	.elem = elements,
	.elem_count = ARRAY_SIZE(elements),
};

/* Provisioning */
static void provisining_unprovisioned_beacon(
    uint8_t uuid[16],
	bt_mesh_prov_oob_info_t oob_info,
	uint32_t *uri_hash
);
static void provisining_node_added(
    uint16_t idx,
    uint8_t uuid[16],
    uint16_t addr,
    uint8_t num_elem
);

const struct bt_mesh_prov provisioner_prov = {
	.uuid = prov_dev_uuid,
	.unprovisioned_beacon = provisining_unprovisioned_beacon,
	.node_added = provisining_node_added,
};


static void provisining_unprovisioned_beacon(
    uint8_t uuid[16],
	bt_mesh_prov_oob_info_t oob_info,
	uint32_t *uri_hash
) {
	memcpy(node_uuid, uuid, 16);
	k_sem_give(&sem_unprov_beacon);
}

static void provisining_node_added(
    uint16_t idx,
    uint8_t uuid[16],
    uint16_t addr,
    uint8_t num_elem
) {
	node_addr = addr;
	k_sem_give(&sem_node_added);
}

static void setup_cdb(void)
{
	struct bt_mesh_cdb_app_key *key;
	uint8_t app_key[16];
	int err;

	key = bt_mesh_cdb_app_key_alloc(net_idx, app_idx);
	if (key == NULL) {
		LOG_ERR("Failed to allocate app-key 0x%04x", app_idx);
		return;
	}

	bt_rand(app_key, 16);

	err = bt_mesh_cdb_app_key_import(key, 0, app_key);
	if (err) {
		LOG_ERR("Failed to import appkey into cdb. Err:%d", err);
		return;
	}

	if (IS_ENABLED(CONFIG_BT_SETTINGS)) {
		bt_mesh_cdb_app_key_store(key);
	}
}

/* Init */
int provisining_init()
{
	int err = 0;

	/* UUID must be set by now */
	memcpy(dev_uuid, provisioner_prov.uuid, 16);

	k_work_queue_init(&provisioning_queue);
	k_work_queue_start(
		&provisioning_queue,
		provisioning_stack_area,
		K_THREAD_STACK_SIZEOF(provisioning_stack_area),
		CONFIG_BL_MESH_PROVISIONING_PRIORITY,
		&cfg
	);

	return 0;
}

/* Configuration loop */
static void configure_node(struct bt_mesh_cdb_node *node)
{
	NET_BUF_SIMPLE_DEFINE(buf, BT_MESH_RX_SDU_MAX);
	struct bt_mesh_comp_p0_elem elem;
	struct bt_mesh_cdb_app_key *key;
	uint8_t app_key[16];
	struct bt_mesh_comp_p0 comp;
	uint8_t status;
	int err, elem_addr;

	LOG_DBG("Configuring node 0x%04x...", node->addr);

	key = bt_mesh_cdb_app_key_get(app_idx);
	if (key == NULL) {
		LOG_ERR("No app-key 0x%04x", app_idx);
		return;
	}

	err = bt_mesh_cdb_app_key_export(key, 0, app_key);
	if (err) {
		LOG_ERR("Failed to export appkey from cdb. Err:%d", err);
		return;
	}

	/* Add Application Key */
	err = bt_mesh_cfg_cli_app_key_add(net_idx, node->addr, net_idx, app_idx, app_key, &status);
	if (err || status) {
		LOG_ERR("Failed to add app-key (err %d status %d)", err, status);
		return;
	}

	/* Get the node's composition data and bind all models to the appkey */
	err = bt_mesh_cfg_cli_comp_data_get(net_idx, node->addr, 0, &status, &buf);
	if (err || status) {
		LOG_ERR("Failed to get Composition data (err %d, status: %d)",
		       err, status);
		return;
	}

	err = bt_mesh_comp_p0_get(&comp, &buf);
	if (err) {
		LOG_ERR("Unable to parse composition data (err: %d)", err);
		return;
	}

	elem_addr = node->addr;
	while (bt_mesh_comp_p0_elem_pull(&comp, &elem)) {
		LOG_DBG("Element @ 0x%04x: %u + %u models", elem_addr,
		       elem.nsig, elem.nvnd);
		for (int i = 0; i < elem.nsig; i++) {
			uint16_t id = bt_mesh_comp_p0_elem_mod(&elem, i);

			if (id == BT_MESH_MODEL_ID_CFG_CLI ||
			    id == BT_MESH_MODEL_ID_CFG_SRV) {
				continue;
			}
			LOG_DBG("Binding AppKey to model 0x%03x:%04x",
			       elem_addr, id);

			err = bt_mesh_cfg_cli_mod_app_bind(
				net_idx,
				node->addr,
				elem_addr,
				app_idx,
				id,
				&status
			);
			if (err || status) {
				LOG_ERR(
					"Failed to bind SIG model %d (err: %d, status: %d)", id, err, status
				);
			}
		}

		for (int i = 0; i < elem.nvnd; i++) {
			struct bt_mesh_mod_id_vnd id = bt_mesh_comp_p0_elem_mod_vnd(&elem, i);

			LOG_DBG("Binding AppKey to model 0x%03x:%04x:%04x",
			       elem_addr, id.company, id.id);

			err = bt_mesh_cfg_cli_mod_app_bind_vnd(net_idx, node->addr, elem_addr,
							       app_idx, id.id, id.company, &status);
			if (err || status) {
				LOG_ERR(
					"Failed to bind vnd model %d (company %d) (err: %d, status: %d)",
					id.id, id.company, err, status
				);
				continue;
			}
		}

		elem_addr++;
	}

	atomic_set_bit(node->flags, BT_MESH_CDB_NODE_CONFIGURED);

	if (IS_ENABLED(CONFIG_BT_SETTINGS)) {
		bt_mesh_cdb_node_store(node);
	}

	LOG_DBG("Configuration complete");
}

static void configure_self(struct bt_mesh_cdb_node *self)
{
	struct bt_mesh_cdb_app_key *key;
	uint8_t app_key[16];
	uint8_t status = 0;
	int err;

	LOG_DBG("Configuring self...");

	key = bt_mesh_cdb_app_key_get(app_idx);
	if (key == NULL) {
		LOG_ERR("No app-key 0x%04x", app_idx);
		return;
	}

	err = bt_mesh_cdb_app_key_export(key, 0, app_key);
	if (err) {
		LOG_ERR("Failed to export appkey from cdb. Err:%d", err);
		return;
	}

	#if IS_ENABLED(CONFIG_SENSIBLE_DATA)
		LOG_HEXDUMP_INF(app_key, ARRAY_SIZE(app_key), "Appkey is ");
	#endif

	/* Add Application Key */
	err = bt_mesh_cfg_cli_app_key_add(
		self->net_idx, self->addr, self->net_idx, app_idx,app_key, &status
	);
	if (err || status) {
		LOG_ERR(
			"Failed to add app-key (err %d, status %d)", err, status
		);
		return;
	}

	atomic_set_bit(self->flags, BT_MESH_CDB_NODE_CONFIGURED);

	if (IS_ENABLED(CONFIG_BT_SETTINGS)) {
		bt_mesh_cdb_node_store(self);
	}

	LOG_DBG("Configuration complete");
}

static uint8_t provisioning_check_unconfigured(struct bt_mesh_cdb_node *node, void *data)
{
	if (!atomic_test_bit(node->flags, BT_MESH_CDB_NODE_CONFIGURED)) {
		if (node->addr == self_addr) {
			configure_self(node);
		} else {
			configure_node(node);
		}
	}

	return BT_MESH_CDB_ITER_CONTINUE;
}

static int provisioning_step(void) {
    char uuid_hex_str[32 + 1] = { 0 };
    
	k_sem_reset(&sem_unprov_beacon);
	k_sem_reset(&sem_node_added);
	bt_mesh_cdb_node_foreach(provisioning_check_unconfigured, NULL);

	LOG_DBG("Waiting for unprovisioned beacon...");
	int err = k_sem_take(&sem_unprov_beacon, K_SECONDS(10));
	if (err < 0) {
		return err;
	}

	bin2hex(node_uuid, 16, uuid_hex_str, sizeof(uuid_hex_str));

	LOG_DBG("Provisioning %s", uuid_hex_str);
	err = bt_mesh_provision_adv(node_uuid, net_idx, 0, 0);
	if (err < 0) {
		LOG_DBG("Provisioning failed (err %d)", err);
		return err;
	}

	LOG_DBG("Waiting for node to be added...");
	err = k_sem_take(&sem_node_added, K_SECONDS(10));
	if (err < 0) {
		LOG_DBG("Timeout waiting for node to be added (err: %d)", err);
		return err;
	}

	LOG_DBG("Added node 0x%04x", node_addr);
	return 0;
}

static void provisioning_work_cb(struct k_work *item) {
	struct k_work_delayable *dwork = k_work_delayable_from_work(item);
	provisioning_step();
	int error_code = k_work_reschedule_for_queue(&provisioning_queue, dwork, K_SECONDS(5));
	if(error_code < 0) {
		LOG_ERR("Failed to reschedule provisioning work (err %d)", error_code);
	}
}

K_WORK_DELAYABLE_DEFINE(provisioning_work, provisioning_work_cb);

int provisioning_start(void) {

	uint8_t net_key[16] = {0};
    uint8_t dev_key[16] = {0};

	if (IS_ENABLED(CONFIG_BT_SETTINGS)) {
		LOG_INF("Loading stored settings");
		settings_load();
	}

	bt_rand(net_key, 16);

	#if IS_ENABLED(CONFIG_SENSIBLE_DATA)
		for(int i = 0; i < 16; i++) {
			net_key[i] = i;
		}
		LOG_HEXDUMP_INF(net_key, ARRAY_SIZE(net_key), "Netkey is ");
	#endif

	int err = bt_mesh_cdb_create(net_key);
	if (err == -EALREADY) {
		LOG_DBG("Using stored CDB");
	} else if (err) {
		LOG_ERR("Failed to create CDB (err %d)", err);
		return err;
	} else {
		LOG_DBG("Created CDB");
		setup_cdb();
	}

	#if IS_ENABLED(CONFIG_SENSIBLE_DATA)
		bt_mesh_cdb_iv_update(0, true);
		LOG_INF("IV index is: %d", 0);
	#endif

	bt_rand(dev_key, 16);

	err = bt_mesh_provision(
        net_key,
        BT_MESH_NET_PRIMARY,
        0,
        0,
        self_addr,
		dev_key
    );

    if (err == -EALREADY) {
		LOG_DBG("Using stored settings");
	} else if (err) {
		LOG_ERR("Provisioning failed (err %d)", err);
		return err;
	} else {
		LOG_DBG("Provisioning completed");
	}

	int error_code = k_work_schedule_for_queue(&provisioning_queue, &provisioning_work, K_NO_WAIT);
	if (error_code < 0) {
		LOG_ERR("Failed to submit provisioning work (err %d)", error_code);
		return error_code;
	}
	return 0;
}
```
